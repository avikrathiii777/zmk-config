## boards/shields/volleycontroller/Kconfig.defconfig
```kconfig
if SHIELD_VOLLEYCONTROLLER

config ZMK_KEYBOARD_NAME
    default "volleycontroller"

endif # SHIELD_VOLLEYCONTROLLER
```

## boards/shields/volleycontroller/Kconfig.shield
```kconfig
config SHIELD_VOLLEYCONTROLLER
    def_bool $(shields_list_contains,volleycontroller)
```
